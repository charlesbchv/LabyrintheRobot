GPIO_PORTF_BASE     EQU     0x40025000

GPIO_O_DIR          EQU     0x00000400
GPIO_O_DR2R   		EQU 	0x00000500
GPIO_O_DEN			EQU		0x0000051C

BROCHE4				EQU		0x10
BROCHE5				EQU		0x20
BROCHE4_5           EQU     0x30
	
		AREA    |.text|, CODE, READONLY
		ENTRY
		
		EXPORT	LED_INIT
		EXPORT	LED_GAUCHE_ON
		EXPORT  LED_GAUCHE_OFF
		EXPORT	LED_DROITE_ON
		EXPORT  LED_DROITE_OFF

LED_INIT
        LDR R6, = GPIO_PORTF_BASE+GPIO_O_DIR
        LDR R0, = BROCHE4_5 	
        STR R0, [R6]
		
		LDR R6, = GPIO_PORTF_BASE+GPIO_O_DEN
        LDR R0, = BROCHE4_5		
        STR R0, [R6]
		
		LDR R6, = GPIO_PORTF_BASE+GPIO_O_DR2R
        LDR R0, = BROCHE4_5			
        STR R0, [R6]
		BX	LR
		
LED_GAUCHE_ON
        MOV R12, #BROCHE5
		LDR R5, = GPIO_PORTF_BASE + (BROCHE5<<2)
		STR R12, [R5]
		BX	LR
		
LED_GAUCHE_OFF
        MOV R12, #0x000
		LDR R5, = GPIO_PORTF_BASE + (BROCHE5<<2)
		STR R12, [R5]
		BX	LR
		
LED_DROITE_ON
        MOV R12, #BROCHE4
		LDR R5, = GPIO_PORTF_BASE + (BROCHE4<<2)
		STR R12, [R5]
		BX	LR
		
LED_DROITE_OFF
        MOV R12, #0x000
		LDR R5, = GPIO_PORTF_BASE + (BROCHE4<<2)
		STR R12, [R5]
		BX	LR
		
		NOP
		END
